## package/mymod/Config.in
```kconfig
config BR2_PACKAGE_MYMOD
    bool "mymod"
    depends on BR2_LINUX_KERNEL
    help
      Simple Linux kernel module.
      Prints Hello World when loaded
      and Bye Bye World when removed.
```
